## Documentation/devicetree/bindings/phy/hisilicon,hi3520dv100-sata-phy.yaml
```yaml
# SPDX-License-Identifier: (GPL-2.0-only OR BSD-2-Clause)
%YAML 1.2
---
$id: http://devicetree.org/schemas/phy/hisilicon,hi3520dv100-sata-phy.yaml#
$schema: http://devicetree.org/meta-schemas/core.yaml#

title: HiSilicon Hi3520D V100 SATA PHY

maintainers:
  - Dylan Corrales <deathcamel58@gmail.com>

description:
  The two-port SATA PHY of the Hi3520D V100. It is configured through
  registers inside the register window of the AHCI controller (PHY control,
  OOB control and the per-port FIFOTH and PHYCTL registers) and has a reset
  bit of its own in the SATA clock and reset register of the CRG. One node
  serves all ports; their number is the size of the "ports" window divided
  by 0x80.

properties:
  compatible:
    const: hisilicon,hi3520dv100-sata-phy

  reg:
    items:
      - description: Global PHY control registers (SATA_TM to SATA_OOB_CTL)
      - description:
          Per-port register blocks, 0x80 bytes per port starting at the first
          port

  reg-names:
    items:
      - const: ctrl
      - const: ports

  '#phy-cells':
    const: 0

  resets:
    items:
      - description: PHY reset (PERI_CRG45 bit 0)

required:
  - compatible
  - reg
  - reg-names
  - '#phy-cells'
  - resets

additionalProperties: false

examples:
  - |
    phy@10080050 {
        compatible = "hisilicon,hi3520dv100-sata-phy";
        reg = <0x10080050 0x28>, <0x10080100 0x100>;
        reg-names = "ctrl", "ports";
        #phy-cells = <0>;
        resets = <&crg 0xb4 0>;
    };
```

## drivers/phy/hisilicon/Kconfig
```kconfig
# SPDX-License-Identifier: GPL-2.0-only
#
# Phy drivers for Hisilicon platforms
#
config PHY_HI6220_USB
	tristate "hi6220 USB PHY support"
	depends on (ARCH_HISI && ARM64) || COMPILE_TEST
	depends on HAS_IOMEM
	select GENERIC_PHY
	select MFD_SYSCON
	help
	  Enable this to support the HISILICON HI6220 USB PHY.

	  To compile this driver as a module, choose M here.

config PHY_HI3660_USB
	tristate "hi3660 USB PHY support"
	depends on (ARCH_HISI && ARM64) || COMPILE_TEST
	select GENERIC_PHY
	select MFD_SYSCON
	help
	  Enable this to support the HISILICON HI3660 USB PHY.

	  To compile this driver as a module, choose M here.

config PHY_HI3670_USB
	tristate "hi3670 USB PHY support"
	depends on (ARCH_HISI && ARM64) || COMPILE_TEST
	select GENERIC_PHY
	select MFD_SYSCON
	help
	  Enable this to support the HISILICON HI3670 USB PHY.

	  To compile this driver as a module, choose M here.

config PHY_HI3670_PCIE
	tristate "hi3670 PCIe PHY support"
	depends on (ARCH_HISI && ARM64) || COMPILE_TEST
	select GENERIC_PHY
	select MFD_SYSCON
	help
	  Enable this to support the HiSilicon hi3670 PCIe PHY.

	  To compile this driver as a module, choose M here.

config PHY_HISTB_COMBPHY
	tristate "HiSilicon STB SoCs COMBPHY support"
	depends on (ARCH_HISI && ARM64) || COMPILE_TEST
	select GENERIC_PHY
	select MFD_SYSCON
	help
	  Enable this to support the HISILICON STB SoCs COMBPHY.
	  If unsure, say N.

config PHY_HISI_INNO_USB2
	tristate "HiSilicon INNO USB2 PHY support"
	depends on ARCH_HISI || COMPILE_TEST
	select GENERIC_PHY
	select MFD_SYSCON
	help
	  Support for INNO USB2 PHY on HiSilicon SoCs. This Phy supports
	  USB 1.5Mb/s, USB 12Mb/s, USB 480Mb/s speeds. It supports one
	  USB host port to accept one USB device.

config PHY_HI3520DV100_SATA
	tristate "HiSilicon Hi3520D V100 SATA PHY support"
	depends on ARCH_HISI_BVT || COMPILE_TEST
	depends on HAS_IOMEM
	select GENERIC_PHY
	help
	  Support for the SATA PHY of the HiSilicon Hi3520D V100 SoC. The
	  PHY is configured through registers inside the register window
	  of the two-port AHCI controller, which is driven by the generic
	  platform AHCI driver (SATA_AHCI_PLATFORM), and through a reset
	  bit of the clock and reset generator. Say Y or M here to use
	  the SATA ports of Hi3520D V100 boards.

config PHY_HIX5HD2_SATA
	tristate "HIX5HD2 SATA PHY Driver"
	depends on ARCH_HIX5HD2 && OF && HAS_IOMEM
	select GENERIC_PHY
	select MFD_SYSCON
	help
	  Support for SATA PHY on Hisilicon hix5hd2 Soc.
```
